## configs/variscite_dart6ulevk_mmc_defconfig
```kconfig
BR2_arm=y
BR2_cortex_a7=y
BR2_ARM_FPU_NEON_VFPV4=y
BR2_TOOLCHAIN_EXTERNAL=y
BR2_GLOBAL_PATCH_DIR="board/variscite/dart6ulevk/patches"
BR2_INIT_SYSTEMD=y
BR2_TARGET_GENERIC_ROOT_PASSWD="root"
BR2_TARGET_GENERIC_GETTY_PORT="ttymxc0"
BR2_SYSTEM_DHCP="eth0"
BR2_SYSTEM_DEFAULT_PATH="/bin:/sbin:/usr/bin:/usr/sbin"
BR2_ROOTFS_OVERLAY="board/variscite/dart6ulevk/rootfs-overlay"
BR2_ROOTFS_POST_BUILD_SCRIPT="board/variscite/dart6ulevk/scripts/post-build.sh"
BR2_ROOTFS_POST_FAKEROOT_SCRIPT="board/variscite/dart6ulevk/scripts/post-fakeroot.sh"
BR2_ROOTFS_POST_IMAGE_SCRIPT="board/variscite/dart6ulevk/scripts/post-image.sh"
BR2_LINUX_KERNEL=y
BR2_LINUX_KERNEL_CUSTOM_GIT=y
BR2_LINUX_KERNEL_CUSTOM_REPO_URL="https://github.com/varigit/linux-imx"
BR2_LINUX_KERNEL_CUSTOM_REPO_VERSION="5.4-2.1.x-imx_var01"
BR2_LINUX_KERNEL_PATCH="linux"
BR2_LINUX_KERNEL_DEFCONFIG="imx_v7_var"
BR2_LINUX_KERNEL_CONFIG_FRAGMENT_FILES="board/variscite/dart6ulevk/linux.fragments"
BR2_LINUX_KERNEL_DTS_SUPPORT=y
BR2_LINUX_KERNEL_INTREE_DTS_NAME="imx6ull-var-dart-6ulcustomboard-emmc-wifi imx6ull-var-dart-6ulcustomboard-emmc-sd-card"
BR2_LINUX_KERNEL_DTB_OVERLAY_SUPPORT=y
BR2_LINUX_KERNEL_NEEDS_HOST_OPENSSL=y
BR2_PACKAGE_BUSYBOX_CONFIG_FRAGMENT_FILES="board/variscite/dart6ulevk/busybox.fragments"
BR2_PACKAGE_I2C_TOOLS=y
BR2_PACKAGE_LIBUBOOTENV=y
BR2_PACKAGE_LIBMODBUS=y
BR2_PACKAGE_OPENSSH=y
BR2_PACKAGE_SOCAT=y
BR2_TARGET_ROOTFS_EXT2=y
BR2_TARGET_ROOTFS_EXT2_4=y
BR2_TARGET_ROOTFS_EXT2_SIZE="128M"
BR2_TARGET_UBOOT=y
BR2_TARGET_UBOOT_BOARDNAME="mx6ul_var_dart_mmc"
BR2_TARGET_UBOOT_CUSTOM_GIT=y
BR2_TARGET_UBOOT_CUSTOM_REPO_URL="https://github.com/varigit/uboot-imx"
BR2_TARGET_UBOOT_CUSTOM_REPO_VERSION="imx_v2018.03_4.14.78_1.0.0_ga_var02"
BR2_TARGET_UBOOT_PATCH="uboot"
BR2_TARGET_UBOOT_NEEDS_DTC=y
BR2_TARGET_UBOOT_NEEDS_OPENSSL=y
BR2_TARGET_UBOOT_FORMAT_IMG=y
BR2_TARGET_UBOOT_SPL=y
BR2_TARGET_UBOOT_SPL_NAME="SPL"
BR2_PACKAGE_HOST_DOSFSTOOLS=y
BR2_PACKAGE_HOST_GENIMAGE=y
BR2_PACKAGE_HOST_MTOOLS=y
```
