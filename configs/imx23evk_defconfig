## configs/imx23evk_defconfig
```kconfig
BR2_arm=y
BR2_TOOLCHAIN_EXTERNAL=y
BR2_TOOLCHAIN_EXTERNAL_BOOTLIN_ARMV5_EABI_GLIBC_STABLE=y
BR2_GLOBAL_PATCH_DIR="board/freescale/common/patches board/freescale/imx23evk/patches"
BR2_ROOTFS_DEVICE_CREATION_DYNAMIC_EUDEV=y
BR2_TARGET_GENERIC_GETTY_PORT="ttyAMA0"
BR2_ROOTFS_OVERLAY="board/freescale/imx23evk/rootfs-overlay"
BR2_ROOTFS_POST_IMAGE_SCRIPT="board/freescale/common/mxs/post-image.sh board/freescale/imx23evk/post-image.sh"
BR2_LINUX_KERNEL=y
BR2_LINUX_KERNEL_CUSTOM_VERSION=y
BR2_LINUX_KERNEL_CUSTOM_VERSION_VALUE="6.6.143"
BR2_LINUX_KERNEL_DEFCONFIG="mxs"
BR2_LINUX_KERNEL_CONFIG_FRAGMENT_FILES="board/freescale/imx23evk/linux.fragment"
BR2_LINUX_KERNEL_DTS_SUPPORT=y
BR2_LINUX_KERNEL_INTREE_DTS_NAME="nxp/mxs/imx23-evk nxp/mxs/imx23-evk-enc28j60"
BR2_PACKAGE_BUSYBOX_CONFIG_FRAGMENT_FILES="board/freescale/imx23evk/busybox.fragment"
BR2_PACKAGE_ALSA_UTILS=y
# BR2_PACKAGE_ALSA_UTILS_ALSAMIXER is not set
BR2_PACKAGE_ALSA_UTILS_AMIXER=y
BR2_PACKAGE_ALSA_UTILS_APLAY=y
BR2_PACKAGE_ALSA_UTILS_SPEAKER_TEST=y
BR2_PACKAGE_MMC_UTILS=y
BR2_PACKAGE_MTD=y
BR2_PACKAGE_MTD_FSCKUBIFS=y
BR2_PACKAGE_MTD_LSMTD=y
BR2_PACKAGE_MTD_MKFSUBIFS=y
BR2_PACKAGE_MTD_MTDPART=y
BR2_PACKAGE_MTD_NANDFLIPBITS=y
BR2_PACKAGE_MTD_TESTS=y
BR2_PACKAGE_MTD_FLASH_READTEST=y
BR2_PACKAGE_MTD_FLASH_SPEED=y
BR2_PACKAGE_MTD_NANDBITERRS=y
BR2_PACKAGE_FB_TEST_APP=y
BR2_PACKAGE_EVTEST=y
BR2_PACKAGE_FREESCALE_IMX=y
BR2_PACKAGE_IMX_KOBS=y
BR2_PACKAGE_LIBGPIOD=y
BR2_PACKAGE_LIBGPIOD_TOOLS=y
BR2_PACKAGE_ETHTOOL=y
BR2_TARGET_ROOTFS_CPIO=y
BR2_TARGET_ROOTFS_CPIO_GZIP=y
BR2_TARGET_ROOTFS_EXT2=y
BR2_TARGET_ROOTFS_EXT2_4=y
# BR2_TARGET_ROOTFS_TAR is not set
BR2_TARGET_MXS_BOOTLETS=y
BR2_TARGET_MXS_BOOTLETS_UBOOT=y
BR2_TARGET_MXS_BOOTLETS_STMP378x=y
BR2_TARGET_UBOOT=y
BR2_TARGET_UBOOT_BUILD_SYSTEM_KCONFIG=y
BR2_TARGET_UBOOT_CUSTOM_GIT=y
BR2_TARGET_UBOOT_CUSTOM_REPO_URL="https://github.com/xaelsouth/u-boot.git"
BR2_TARGET_UBOOT_CUSTOM_REPO_VERSION="feature/imx23"
BR2_TARGET_UBOOT_BOARD_DEFCONFIG="mx23evk"
BR2_TARGET_UBOOT_CONFIG_FRAGMENT_FILES="board/freescale/imx23evk/uboot.fragment"
BR2_TARGET_UBOOT_FORMAT_SB=y
BR2_TARGET_UBOOT_FORMAT_SD=y
BR2_TARGET_UBOOT_SPL=y
BR2_PACKAGE_HOST_DOSFSTOOLS=y
BR2_PACKAGE_HOST_ELFTOSB=y
BR2_PACKAGE_HOST_GENIMAGE=y
BR2_PACKAGE_HOST_IMX_SB_LOADER=y
BR2_PACKAGE_HOST_MTOOLS=y
BR2_PACKAGE_HOST_UBOOT_TOOLS=y
BR2_PACKAGE_HOST_UBOOT_TOOLS_FIT_SUPPORT=y
BR2_PACKAGE_HOST_UBOOT_TOOLS_FIT_SIGNATURE_SUPPORT=y
```

## package/elftosb/Config.in.host
```kconfig
config BR2_PACKAGE_HOST_ELFTOSB
	bool "host-elftosb"
	help
		Elftosb is a Freescale toolset to build binary image files (like U-Boot.sb)
		to be used with CPUs imx23, imx28, stp37xx
```

## package/freescale-imx/imx-sm/Config.in
```kconfig
config BR2_PACKAGE_IMX_SM
	bool "imx-sm"
	help
	  imx-sm contains the source code for the System Manager (SM)
	  firmware used on NXP SoCs such as MX95 and MX943.

	  https://github.com/nxp-imx/imx-sm

if BR2_PACKAGE_IMX_SM
config BR2_PACKAGE_IMX_SM_CFG
	string "Target configuration"
	default "mx95evk"
	help
	  Which configuration to use in the build process.
endif # BR2_PACKAGE_IMX_SM
```

## package/imx-sb-loader/Config.in.host
```kconfig
config BR2_PACKAGE_HOST_IMX_SB_LOADER
	bool "host-imx-sb-loader"
	help
		iMX SB Loader is a tool to download binary image files (like U-Boot.sb)
		to be used with CPUs imx23, imx28, stp37xx. It is using USB protocol.
```
